## sysmain/os/framework/bt/Kconfig
```kconfig
config FRAMEWORK_BT_AQ
    bool "Bluetooth Audio Quality Framework"
    default y
```

## sysmain/os/framework/wf_handle/Kconfig
```kconfig
config FRAMEWORK_WIFI_AQUARIUM
    bool "WiFi Handler Aquarium Framework"
    default y
```
